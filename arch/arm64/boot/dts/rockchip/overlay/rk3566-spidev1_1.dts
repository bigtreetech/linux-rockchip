/dts-v1/;
/plugin/;

/ {
	fragment@0 {
		target = <&spi1>;
		__overlay__ {
			status = "okay";
			#address-cells = <1>;
			#size-cells = <0>;
			spidev1_1: spidev@1 {
				status = "okay";
				compatible = "rockchip,spidev";
				spi-max-frequency = <1000000>;
				reg = <1>;
			};
		};
	};
};
