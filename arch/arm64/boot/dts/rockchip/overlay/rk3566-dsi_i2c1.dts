/dts-v1/;
/plugin/;

/ {

	#include "rk3566-dsi_panel.dtsi"

	fragment@8 {
		target = <&i2c1>;
		__overlay__ {
			#address-cells = <1>;
			#size-cells = <0>;
			status = "okay";
			#include "rk3566-dsi_i2c_devices.dtsi"
		};
	};

	fragment@9 {
		target = <&dsi1_panel>;
		__overlay__ {
			backlight = <&bl_dsi>;
		};
	};
};
