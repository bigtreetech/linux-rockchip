/dts-v1/;
/plugin/;

/ {
	#include "rk3566-display.dtsi"

	// Enable HDMI
	fragment@4 {
		target = <&hdmi_sound>;
		__overlay__ {
			status = "okay";
		};
	};

	fragment@5 {
		target = <&i2s0_8ch>;
		__overlay__ {
			status = "okay";
		};
	};

	fragment@6 {
		target = <&hdmi>;
		__overlay__ {
			status = "okay";
		};
	};

	fragment@7 {
		target = <&hdmi_in_vp0>;
		__overlay__ {
			status = "okay";
		};
	};
};
