/dts-v1/;
/plugin/;

/ {
	// Enable TFT35 display
	fragment@0 {
		target = <&spi1>;
		__overlay__ {
			status = "okay";
		};
	};

	fragment@1 {
		target = <&tft_35>;
		__overlay__ {
			status = "okay";
		};
	};

	// Enable TFT35 touchscreen
	fragment@2 {
		target = <&i2c3>;
		__overlay__ {
			status = "okay";
		};
	};

	fragment@3 {
		target = <&tp_ns2009>;
		__overlay__ {
			status = "okay";
		};
	};
};
