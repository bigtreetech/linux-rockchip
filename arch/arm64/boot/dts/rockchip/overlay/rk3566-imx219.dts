/dts-v1/;
/plugin/;

/ {
	#include "rk3566-csi_phy.dtsi"

	fragment@7 {
		target = <&i2c2>;
		__overlay__ {
			status = "okay";
		};
	};

	fragment@8 {
		target = <&imx219>;
		__overlay__ {
			status = "okay";
		};
	};
};
