/dts-v1/;
/plugin/;

/ {
	// Enable TFT43 display
	fragment@0 {
		target = <&spi1>;
		__overlay__ {
			status = "okay";
		};
	};

	fragment@1 {
		target = <&tft_43>;
		__overlay__ {
			status = "okay";
		};
	};

	// Enable TFT43 touchscreen
	fragment@2 {
		target = <&i2c3>;
		__overlay__ {
			status = "okay";
		};
	};

	fragment@3 {
		target = <&tp_tft43>;
		__overlay__ {
			status = "okay";
		};
	};
};
