/dts-v1/;
/plugin/;

/ {
	fragment@0 {
		target = <&spi1>;
		__overlay__ {
			status = "okay";
			rockchip,poll-only = <1>;
		};
	};

	fragment@1 {
		target = <&can>;
		__overlay__ {
			status = "okay";
		};
	};
};
